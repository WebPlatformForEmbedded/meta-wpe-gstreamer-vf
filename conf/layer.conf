## conf/layer.conf
```bitbake
BBPATH .= ":${LAYERDIR}"

BBFILES += "\
            ${LAYERDIR}/recipes-*/*/*.bb \
            ${LAYERDIR}/recipes-*/*/*.bbappend \
           "

BBFILE_COLLECTIONS += "wpe-gstreamer-vf-layer"
BBFILE_PATTERN_wpe-gstreamer-vf-layer := "^${LAYERDIR}/"
BBFILE_PRIORITY_wpe-gstreamer-vf-layer = "21"

LAYERSERIES_COMPAT_wpe-gstreamer-vf-layer = "sumo"

LAYERDEPENDS_wpe-gstreamer-vf-layer = "core \
                          openembedded-layer \
                          multimedia-layer \
                          networking-layer \
                          meta-python \
                         "


# WPE needs mpg123 gstreamer plugin
LICENSE_FLAGS_WHITELIST += "commercial_mpg123"
LICENSE_FLAGS_WHITELIST += "commercial_gstreamer1.0-wpe-plugins-ugly"

# WPE on rpi needs the OpenMAX gstreamer plugin
LICENSE_FLAGS_WHITELIST += "commercial_libomxil"
LICENSE_FLAGS_WHITELIST += "commercial_gstreamer1.0-wpe-omx"

# Ignore the ones meta-wpe brings
BBMASK += 'meta-wpe/recipes-multimedia/gstreamer/*'

# For testing, we should remove this later down the road?
BBMASK += 'poky/meta/recipes-multimedia/gstreamer/*'
BBMASK += 'openembedded-core/recipes-multimedia/gstreamer/*'
```
